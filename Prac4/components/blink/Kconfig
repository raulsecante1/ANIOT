## Prac4/components/blink/Kconfig
```kconfig
menu "Blink Configuration"

config BLINK_GPIO
    int "Blink GPIO number"
    default 2
    help
        GPIO for the onboard WS2812 LED.

config BLINK_PERIOD
    int "Blink period in ms"
    default 1000
    help
        Blink interval in milliseconds.

endmenu
```

## Prac4/components/neo_i2c/Kconfig
```kconfig
menu "I2C Configuration"

config I2C_SDA_GPIO
    int "I2C SDA pin"
    default 10
    help
        GPIO number used for SDA.

config I2C_SCL_GPIO
    int "I2C SCL pin"
    default 8
    help
        GPIO number used for SCL.

endmenu
```
